## config/west.yml
```yaml
manifest:
  defaults:
    remote: urob
    revision: v0.3
  remotes:
    - name: urob
      url-base: https://github.com/urob
    - name: zmkfirmware
      url-base: https://github.com/zmkfirmware
    # Additional modules containing boards/shields/custom code can be listed here as well
    # See https://docs.zephyrproject.org/3.2.0/develop/west/manifest.html#projects
    # support nice_oled and nice_epaper
    - name: mctechnology17
      url-base: https://github.com/mctechnology17
    - name: infely
      url-base: https://github.com/infely
    - name: joelspadin
      url-base: https://github.com/joelspadin
  projects:
    - name: zmk
      remote: zmkfirmware
      revision: v0.3
      import: app/west.yml

    # ZMK modules
    - name: zmk-adaptive-key
      path: modules/zmk/adaptive-key
    - name: zmk-auto-layer
      path: modules/zmk/auto-layer
    - name: zmk-helpers
      path: modules/zmk/helpers
    - name: zmk-leader-key
      path: modules/zmk/leader-key
    - name: zmk-tri-state
      path: modules/zmk/tri-state
    - name: zmk-unicode
      path: modules/zmk/unicode

    # support nice_oled and nice_epaper
    - name: zmk-nice-oled
      remote: mctechnology17
      revision: v0.3
      path: modules/zmk/nice-oled
    - name: nice-view-battery
      remote: infely
      revision: v0.3
      path: modules/zmk/nice-view-battery
    - name: zmk-locales
      remote: joelspadin
      revision: v0.3
      path: modules/zmk/locales

    # Temporarily overload Zephyr until upstream fix lands
    - name: zephyr
      revision: v3.5.0+zmk-fixes
      clone-depth: 1
      import:
        name-allowlist:
          - cmsis
          - hal_nordic
          - hal_rpi_pico
          - hal_stm32
          - lvgl
          - tinycrypt
  self:
    path: config
```
